## boards/gd/gd32e230_eval/Kconfig.board
```kconfig
# SPDX-License-Identifier: Apache-2.0

config BOARD_GD32E230_EVAL
	bool "GD32E230 EVAL Board"
	depends on SOC_SERIES_GD32E23X
```

## boards/gd/gd32e230_eval/Kconfig.gd32e230_eval
```kconfig
# Copyright (c) 2021 Nordic Semiconductor ASA
# SPDX-License-Identifier: Apache-2.0

config BOARD_GD32E230_EVAL
	select SOC_GD32E230
```

## boards/gd/gd32e230_eval/board.yml
```yaml
# Copyright (c) 2024 Nordic Semiconductor ASA
# SPDX-License-Identifier: Apache-2.0

board:
  name: gd32e230_eval
  vendor: gd
  socs:
    - name: gd32e230
```

## boards/gd/gd32e230_eval/gd32e230_eval_defconfig
```kconfig
# SPDX-License-Identifier: Apache-2.0

CONFIG_SOC_SERIES_GD32E23X=y
CONFIG_SOC_GD32E230=y

CONFIG_MAIN_STACK_SIZE=512
CONFIG_IDLE_STACK_SIZE=256
CONFIG_ISR_STACK_SIZE=1024
```

## soc/gd/gd32/Kconfig
```kconfig
config SOC_FAMILY_GD_GD32
	select HAS_SEGGER_RTT if ZEPHYR_SEGGER_MODULE

if SOC_FAMILY_GD_GD32

rsource "*/Kconfig"

endif # SOC_FAMILY_GD_GD32
```

## soc/gd/gd32/gd32e23x/Kconfig.defconfig
```kconfig
# SPDX-License-Identifier: Apache-2.0

if SOC_GD32E230

config SOC_PART_NUMBER
	default "GD32E230C8T6"

config SYS_CLOCK_HW_CYCLES_PER_SEC
	default $(dt_node_int_prop_int,/cpus/cpu@0,clock-frequency)

config NUM_IRQS
    default 32

endif # SOC_GD32E230
```

## soc/gd/gd32/gd32e23x/Kconfig.defconfig.series
```kconfig
if SOC_SERIES_GD32E23X

rsource "Kconfig.defconfig.gd32*"

endif # SOC_SERIES_GD32E23X
```

## soc/gd/gd32/gd32e23x/Kconfig.soc
```kconfig
# SPDX-License-Identifier: Apache-2.0

config SOC_SERIES_GD32E23X
	bool "GD32E23x Series"
	select ARM
	select CPU_CORTEX_M23
	select CPU_CORTEX_M_HAS_SYSTICK
	select CPU_CORTEX_M_HAS_VTOR
	select SOC_EARLY_INIT_HOOK
	select SOC_FAMILY_GD_GD32
	select BUILD_OUTPUT_HEX
	
	help
	  Enable support for GigaDevice GD32E23x series

config SOC_SERIES
	default "gd32e23x" if SOC_SERIES_GD32E23X

config SOC_GD32E230
    bool "GD32E230"

config SOC
    default "gd32e230" if SOC_GD32E230

default GD32_HXTAL_8MHZ if SOC_SERIES_GD32E23X
```

## west.yml
```yaml
# Copyright (c) 2021 Nordic Semiconductor ASA
# SPDX-License-Identifier: Apache-2.0

manifest:
  remotes:
    - name: zephyrproject-rtos
      url-base: https://github.com/zephyrproject-rtos

  projects:
    - name: zephyr
      remote: zephyrproject-rtos
      revision: v4.2.0
      import:
        name-allowlist:
          - cmsis
          - cmsis_6
          - hal_stm32
```
